## src/Kconfig.projbuild
```kconfig
menu "Configuração do Wifi"

    config ESP_WIFI_SSID
        string ""
        default ""
        help
            Nome da rede Wifi.

    config ESP_WIFI_PASSWORD
        string ""
        default ""
        help
            Senha do WiFi (WPA or WPA2).

    config ESP_MAXIMUM_RETRY
        int "Número máximo de tentativas de conexão"
        default 5
        help
            Configure o valor máximo de tentativas de conexão.
endmenu

menu "Outros"
    config ESP_WIFI_PASSWORD
        string "alexandreogrande"
        default "alexandreogrande"
        help
            Senha do WiFi (WPA or WPA2).
endmenu
```
